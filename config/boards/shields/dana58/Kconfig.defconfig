## config/boards/shields/dana58/Kconfig.defconfig
```kconfig
if SHIELD_DANA58_LEFT

config ZMK_KEYBOARD_NAME
    default "dana58"

config ZMK_SPLIT_ROLE_CENTRAL
    default y

endif

if SHIELD_DANA58_LEFT || SHIELD_DANA58_RIGHT

config ZMK_SPLIT
    default y

endif
```

## config/boards/shields/dana58/Kconfig.shield
```kconfig
config SHIELD_DANA58_LEFT
    def_bool $(shields_list_contains,dana58_left)

config SHIELD_DANA58_RIGHT
    def_bool $(shields_list_contains,dana58_right)
```
